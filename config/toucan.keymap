// Copyright 2021 Manna Harbour
// https://github.com/manna-harbour/miryoku
//
// Miryoku layout for the beekeeb Toucan 36 (3x5 + 3 thumbs per hand).
// Engine vendored from https://github.com/manna-harbour/miryoku_zmk into config/miryoku.
// It lives under config/ so the ZMK build's isolated `cp -R config/*` copy keeps the
// engine reachable from this keymap's relative includes.
// Customise the layout (alphas, layers, clipboard OS, kludges, etc.) in
// config/miryoku/custom_config.h -- see the miryoku_zmk readme for options.

// U_TOUCAN enables the trackpad-specific left-thumb Mouse layer override in
// custom_config.h (the PocketCorne build omits this and gets the stock layer).
#define U_TOUCAN

#include "miryoku/custom_config.h"
#include "miryoku/mapping/42/toucan.h"
#include "miryoku/miryoku.dtsi"

// Positional home-row mods: the base layer (overridden in custom_config.h) binds
// the alpha mod-taps to &hml/&hmr, defined here. Included after miryoku.dtsi so
// U_TAPPING_TERM is available; the keymap forward-references the labels.
// balanced + require-prior-idle stop fast-roll misfires, hold-trigger-key-positions
// add the opposite-hands rule, quick-tap enables tap-then-hold auto-repeat. Thumb
// layer-taps (u_lt) stay at Miryoku defaults so layer access stays instant.
#include "miryoku/custom_behaviors.dtsi"
