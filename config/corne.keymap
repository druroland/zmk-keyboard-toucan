// Copyright 2021 Manna Harbour
// https://github.com/manna-harbour/miryoku
//
// Miryoku layout for the PocketCorne (42-key Corne wired as 36 -- outer columns
// dropped). Shares the vendored Miryoku engine, Colemak-DH alphas, and the
// positional home-row mods (hml/hmr) with the Toucan; the only differences are
// the physical mapping (corne vs toucan) and the hardware (config/corne.conf).
//
// No U_TOUCAN: the PocketCorne has no trackpad, so it uses the stock Miryoku
// Mouse layer (right-thumb buttons).

#include "miryoku/custom_config.h"
#include "miryoku/mapping/42/corne.h"
#include "miryoku/miryoku.dtsi"
#include "miryoku/custom_behaviors.dtsi"
